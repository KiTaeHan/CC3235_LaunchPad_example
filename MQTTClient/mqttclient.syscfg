/**
 * @cliArgs --board "/ti/boards/CC3235SF_LAUNCHXL" --rtos "freertos" --product "simplelink_cc32xx_sdk@6.10.00.05"
 * @versions {"tool":"1.12.0+2406"}
 */

/**
 * Import the modules used in this configuration.
 */
const Display        = scripting.addModule("/ti/display/Display", {}, false);
const Display1       = Display.addInstance();
const GPIO           = scripting.addModule("/ti/drivers/GPIO");
const GPIO1          = GPIO.addInstance();
const GPIO2          = GPIO.addInstance();
const Power          = scripting.addModule("/ti/drivers/Power");
const SPI            = scripting.addModule("/ti/drivers/SPI");
const SimpleLinkWifi = scripting.addModule("/ti/drivers/net/wifi/SimpleLinkWifi");
const MQTT           = scripting.addModule("/ti/net/MQTT", {}, false);
const MQTT1          = MQTT.addInstance();
const SlNet          = scripting.addModule("/ti/net/SlNet", {}, false);
const SlNet1         = SlNet.addInstance();

/**
 * Write custom configuration values to the imported modules.
 */
Display1.$name      = "CONFIG_Display_0";
Display1.$hardware  = system.deviceData.board.components.XDS110UART;
Display1.uart.$name = "CONFIG_UART2_0";

GPIO1.$hardware = system.deviceData.board.components.LED_BLUE;
GPIO1.$name     = "CONFIG_GPIO_LED_0";

GPIO2.$hardware        = system.deviceData.board.components.SW2;
GPIO2.$name            = "CONFIG_GPIO_BUTTON_0";
GPIO2.interruptTrigger = "Rising Edge";
GPIO2.callbackFunction = "";

Power.parkPins.$name = "ti_drivers_power_PowerCC32XXPins0";

MQTT1.$name = "CONFIG_MQTT_0";

SlNet1.$name = "CONFIG_SLNET_0";

/**
 * Pinmux solution for unlocked pins/peripherals. This ensures that minor changes to the automatic solver in a future
 * version of the tool will not impact the pinmux you originally saw.  These lines can be completely deleted in order to
 * re-solve from scratch.
 */
Display1.uart.uart.$suggestSolution              = "UART1";
Display1.uart.uart.txPin.$suggestSolution        = "ball.55";
Display1.uart.uart.txDmaChannel.$suggestSolution = "UDMA_CH11";
Display1.uart.uart.rxPin.$suggestSolution        = "ball.57";
Display1.uart.uart.rxDmaChannel.$suggestSolution = "UDMA_CH10";
GPIO1.gpioPin.$suggestSolution                   = "boosterpack.29";
GPIO2.gpioPin.$suggestSolution                   = "boosterpack.3";
