/**
 * @cliArgs --board "/ti/boards/CC3235SF_LAUNCHXL" --rtos "freertos" --product "simplelink_cc32xx_sdk@6.10.00.05"
 * @versions {"tool":"1.12.0+2406"}
 */

/**
 * Import the modules used in this configuration.
 */
const GPIO           = scripting.addModule("/ti/drivers/GPIO");
const GPIO1          = GPIO.addInstance();
const Power          = scripting.addModule("/ti/drivers/Power");
const SPI            = scripting.addModule("/ti/drivers/SPI");
const UART2          = scripting.addModule("/ti/drivers/UART2", {}, false);
const UART21         = UART2.addInstance();
const SimpleLinkWifi = scripting.addModule("/ti/drivers/net/wifi/SimpleLinkWifi");
const HTTPClient     = scripting.addModule("/ti/net/HTTPClient", {}, false);
const HTTPClient1    = HTTPClient.addInstance();
const SlNet          = scripting.addModule("/ti/net/SlNet", {}, false);
const SlNet1         = SlNet.addInstance();

/**
 * Write custom configuration values to the imported modules.
 */
GPIO1.$hardware = system.deviceData.board.components.LED_BLUE;
GPIO1.$name     = "CONFIG_GPIO_LED_0";

Power.parkPins.$name = "ti_drivers_power_PowerCC32XXPins0";

UART21.$name     = "CONFIG_UART2_0";
UART21.$hardware = system.deviceData.board.components.XDS110UART;

HTTPClient1.$name = "CONFIG_HTTPCLIENT_0";

SlNet1.$name = "CONFIG_SLNET_0";

/**
 * Pinmux solution for unlocked pins/peripherals. This ensures that minor changes to the automatic solver in a future
 * version of the tool will not impact the pinmux you originally saw.  These lines can be completely deleted in order to
 * re-solve from scratch.
 */
GPIO1.gpioPin.$suggestSolution            = "boosterpack.29";
UART21.uart.$suggestSolution              = "UART0";
UART21.uart.txPin.$suggestSolution        = "GP01";
UART21.uart.txDmaChannel.$suggestSolution = "UDMA_CH9";
UART21.uart.rxPin.$suggestSolution        = "GP02";
UART21.uart.rxDmaChannel.$suggestSolution = "UDMA_CH8";
